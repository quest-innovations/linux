## Documentation/devicetree/bindings/display/altr,vip-fb2.txt
```
Intel Video and Image Processing(VIP) Frame Buffer II bindings

Supported hardware: Intel FPGA SoC Arria10 and above with display port IP

The Video Frame Buffer II in Video Image Processing (VIP) suite is an IP core
that interfaces between system memory and Avalon-ST video ports. The IP core
can be configured to support the memory reader (from memory to Avalon-ST)
and/or memory writer (from Avalon-ST to memory) interfaces.

More information the FPGA video IP component can be acquired from
https://www.altera.com/content/dam/altera-www/global/en_US/pdfs\
/literature/ug/ug_vip.pdf

DT-Bindings:
=============
Required properties:
----------------------------
- compatible: "altr,vip-frame-buffer-2.0"
- reg: Physical base address and length of the framebuffer controller's
	registers.
- altr,max-width: The maximum width of the framebuffer in pixels.
- altr,max-height: The maximum height of the framebuffer in pixels.
- altr,mem-port-width = the bus width of the avalon master port
	on the frame reader

Connections between the Frame Buffer II and other video IP cores in the system
are modelled using the OF graph DT bindings. The Frame Buffer II node has up
to two OF graph ports. When the memory writer interface is enabled, port 0
maps to the Avalon-ST Input (din) port. When the memory reader interface is
enabled, port 1 maps to the Avalon-ST Output (dout) port.

The encoder is built into the FPGA HW design and therefore would not
be accessible from the DDR.

		Port 0				Port1
---------------------------------------------------------
ARRIA10 AVALON_ST (DIN)		AVALON_ST (DOUT)

Example:
----------------------------

           +------------------------------+
           |        FPGA                  |    +------------+
           +---------+ +--------------+   |    |  DP        |
+-----+    |  VIP    | | DP           |   +---->  Connector |
|     |    |  Frame  | | Controller   |   |    |            |
| D   +---->  Buffer | +--------------+   |    +------------+
| D   |    |         | +--------------+   |
| R   |    |         | | DP           |   |
|     |    +---------+ | Encoder      |   |
|     |    |           +--------------+   |
+-----+    +------------------------------+


framebuffer@100000280 {
        compatible = "altr,vip-frame-buffer-2.0";
        reg = <0x00000001 0x00000280 0x00000040>;
        altr,max-width = <1280>;
        altr,max-height = <720>;
        altr,mem-port-width = <128>;

        ports {
                #address-cells = <1>;
                #size-cells = <0>;

                port@1 {
                        reg = <1>;
                        fb_output: endpoint {
                                remote-endpoint = <&dp_encoder_input>;
                        };
                };
        };
};
```

## Documentation/devicetree/bindings/dma/quest-dma.txt
```
Usage examples of the quest dma kernel modules




Part 1 generally in the socfpga.dtsi file:

clink_to_av_master_0: quest_dma_ctrl@0x000004400 {
	compatible = "uest,qdma-clink-1.0.0";
	reg = <0x00000000 0x00004400 0x00000040>;
	clocks = <&h2f_user0_clk &h2f_user0_clk>;
	clock-names = "clock_write", "clock_slave";
	interrupt-parent = <&intc>;
	interrupts = <0 42 IRQ_TYPE_EDGE_RISING>;
	status = "disabled";
};

Part 2 in the board specific file:

&clink_to_av_master_0 {
	compatible = "quest,qdma-clink-1.0.0";
	device = "qdma_clink_0";
	status = "okay";
};


Part 1 generally in the socfpga.dtsi file:

ez_usb_dma_0: quest_dma_ctrl@0x000004540 {
	compatible = "quest,qdma-fx3-1.0.0";
	reg = <0x00000000 0x000004540 0x00000040>;
	clocks = <&h2f_user0_clk &h2f_user0_clk>;
	clock-names = "clock_write", "clock_slave";
	interrupt-parent = <&intc>;
	interrupts = <0 43 IRQ_TYPE_EDGE_RISING>;
	status = "disabled";
};


Part 2 in the board specific file:

&ez_usb_dma_0 {
	compatible = "quest,qdma-fx3-1.0.0";
	device = "qdma_fx3_0";
	status = "okay";
};
```

## drivers/dma/quest/Kconfig
```kconfig
config QUEST_DMA
	tristate "Quest DMA Controller"
	depends on ARCH_SOCFPGA
	select DMA_ENGINE
	help
	  Enable support for Quest DMA control

	  ASpicy jalapeno bacon ipsum dolor amet pork loin leberkas jerky 
	  prosciutto, shoulder spare ribs ground round rump. Beef ribs shank
	  doner, rump kielbasa ball tip cow swine beef bresaola pork belly
	  tri-tip ham. Pork chop leberkas t-bone pastrami short ribs. Picanha
	  rump tenderloin beef ribs flank cupim beef pork loin bacon meatloaf
	  leberkas bresaola pastrami.
```

## drivers/gpu/drm/ivip/Kconfig
```kconfig
config DRM_IVIP
        tristate "Intel FGPA Video and Image Processing"
        depends on DRM && OF
        select DRM_GEM_CMA_HELPER
        select DRM_KMS_HELPER
        select DRM_KMS_FB_HELPER
        select DRM_KMS_CMA_HELPER
        help
            Choose this option if you have a Intel FPGA Arria 10 system
            and above with a Display Port IP. This does not support legacy
            Intel FPGA Cyclone V display port. Currently only single frame
            buffer is supported. Note that ACPI and X_86 architecture is yet
            to be supported.If M is selected the module would be called ivip.
```
