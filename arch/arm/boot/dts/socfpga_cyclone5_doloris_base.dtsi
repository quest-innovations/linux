/*
 *  Copyright (C) 2017 Quest Innovations <www.quest-innovations.com>
 *
 * This program is free software; you can redistribute it and/or modify
 * it under the terms of the GNU General Public License as published by
 * the Free Software Foundation; either version 2 of the License, or
 * (at your option) any later version.
 *
 * This program is distributed in the hope that it will be useful,
 * but WITHOUT ANY WARRANTY; without even the implied warranty of
 * MERCHANTABILITY or FITNESS FOR A PARTICULAR PURPOSE.  See the
 * GNU General Public License for more details.
 *
 * You should have received a copy of the GNU General Public License
 * along with this program.  If not, see <http://www.gnu.org/licenses/>.
 */

/dts-v1/;

#include "socfpga_cyclone5.dtsi"

/ {
	soc {
		fpga_bridge1{
			compatible = "altr,socfpga-hps2fpga-bridge";
			reg = <0xc0000000 0x20000000>;
			resets = <&rst HPS2FPGA_RESET>;
			clocks = <&l4_main_clk>;
			#address-cells = <2>;
			#size-cells = <1>;
		};

	};
};